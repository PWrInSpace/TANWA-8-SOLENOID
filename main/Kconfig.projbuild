## main/Kconfig.projbuild
```kconfig
menu "TANWA BOARD CONFIGURATION"

    menu "TASK CONFIGURATION"

        menu "SETUP TASK"

            config SETUP_TASK_STACK_SIZE
                int "Stack size"
                default 4096
                help
                    Stack size for setup task.
            
            config SETUP_TASK_PRIORITY
                int "Priority"
                default 5
                help
                    Priority for setup task.

            config SETUP_TASK_CORE_ID
                int "Core ID"
                default 0
                help
                    Core ID for setup task.
            
        endmenu

        menu "CAN TASK"

            config CAN_TASK_STACK_SIZE
                int "Stack size"
                default 4096
                help
                    Stack size for CAN task.
            
            config CAN_TASK_PRIORITY
                int "Priority"
                default 5
                help
                    Priority for CAN task.

            config CAN_TASK_CORE_ID
                int "Core ID"
                default 0
                help
                    Core ID for CAN task.

        endmenu

        menu "APP TASK"

            config APP_TASK_STACK_SIZE
                int "Stack size"
                default 4096
                help
                    Stack size for main task.
            
            config APP_TASK_PRIORITY
                int "Priority"
                default 5
                help
                    Priority for main task.

            config APP_TASK_CORE_ID
                int "Core ID"
                default 1
                help
                    Core ID for main task.

        endmenu
    endmenu

    menu "GPIO CONFIGURATION"

        config GPIO_LED
            int "LED GPIO"
            default 46
            help
                GPIO number for LED.
        
    endmenu

    menu "I2C configuration"

        config I2C_SDA
            int "I2C SDA pin number"
            default 14
            help
                GPIO pin number for I2C SDA

        config I2C_SCL
            int "I2C SCL pin number"
            default 13
            help
                GPIO pin number for I2C SCL

        config I2C_MASTER_PORT_NUM
            int "Port Number"
            default 0
            help
                Port number for I2C Master device.

        config I2C_MASTER_FREQUENCY
            int "Master Frequency"
            default 400000
            help
                I2C frequency of Master device.

        config I2C_MASTER_TIMEOUT_MS
            int "Master Timeout"
            default 1000
            help
                Timeout of I2C Master device.
     endmenu

    menu "CAN CONFIGURATION"

        config CAN_RX_GPIO
            int "TWAI RX PIN"
            default 20
            help
                GPIO number for TWAI RX pin.
        
        config CAN_TX_GPIO
            int "CAN TX PIN"
            default 19
            help
                GPIO number for TWAI TX pin.
        config CAN_STB_GPIO
            int "CAN_STB GPIO pin"
            default 8

        config CAN_TX_QUEUE_LENGTH
            int "TX Queue Length"
            default 10
            help
                Length of the TX queue for CAN messages.

        config CAN_RX_QUEUE_LENGTH
            int "RX Queue Length"
            default 10
            help
                Length of the RX queue for CAN messages.
        
        config TWAI_ACCEPTANCE_CODE
            int "Acceptance Code"
            default 0
            help
                Acceptance code for TWAI filter.
        
        config TWAI_ACCEPTANCE_MASK
            int "Acceptance Mask"
            default 2147483647
            help
                Acceptance mask for TWAI filter.
    endmenu

menu "GPIO CONFIGURATION"
    
    config GPIO_ISENSE
        int "I_SENSE GPIO"
        default 4
        help
            GPIO number for L_SENSE.

    config GPIO_SERVO1
        int "SERVO1 GPIO"
        default 15
        help
            GPIO number for SERVO1.

    config GPIO_SERVO2
        int "SERVO2 GPIO"
        default 7
        help
            GPIO number for SERVO2.
    config GPIO_SERVO3
        int "SERVO3 GPIO"
        default 6
        help
            GPIO number for SERVO3.

    config GPIO_SERVO4
        int "SERVO4 GPIO"
        default 5
        help
            GPIO number for SERVO4.

    
    config GPIO_STALL1_IN
        int "STALL1_IN GPIO"
        default 21
        help
            GPIO number for STALL1_IN.

    config GPIO_STALL2_IN
        int "STALL2_IN GPIO"
        default 16
        help
            GPIO number for STALL2_IN.

    config GPIO_MOTOR1_IN1
        int "MOTOR1_IN1 GPIO"
        default 9
        help
            GPIO number for MOTOR1_IN1.

    config GPIO_MOTOR1_IN2
        int "MOTOR1_IN2 GPIO"
        default 10
        help
            GPIO number for MOTOR1_IN2.

    config GPIO_LIMIT_SWITCH1
        int "LIMIT_SWITCH1 GPIO"
        default 12
        help
            GPIO number for LIMIT_SWITCH1.

    config GPIO_LIMIT_SWITCH2
        int "LIMIT_SWITCH2 GPIO"
        default 11
        help
            GPIO number for LIMIT_SWITCH2.
    

    config GPIO_SOL1
        int "SOL1 GPIO"
        default 48
        help
            GPIO number for SOL1.

    config GPIO_SOL2
        int "SOL2 GPIO"
        default 47
        help
            GPIO number for SOL2.

    config GPIO_SOL3
        int "SOL3 GPIO"
        default 38
        help
            GPIO number for SOL3.

    config GPIO_SOL4
        int "SOL4 GPIO"
        default 37
        help
            GPIO number for SOL4.

    config GPIO_SOL5
        int "SOL5 GPIO"
        default 36
        help
            GPIO number for SOL5.

    config GPIO_SOL6
        int "SOL6 GPIO"
        default 35
        help
            GPIO number for SOL6.

endmenu

endmenu
```
